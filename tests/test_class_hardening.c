/*
 * nano_j2me - tests/test_class_hardening.c
 *
 * Malformed class files must be rejected with a Java exception - not a crash
 * and not a hang.  The input is the checked-in fixture
 * tests/fixtures/hardening_malformed.jar, generated byte-for-byte by
 * tools/make_fuzz_fixture.sh (the classes are malformed at the class-file
 * level, so they cannot come from javac).
 *
 * Every class in it has a static main([Ljava/lang/String;)V and is called
 * through the same public entry point a launcher uses:
 *
 *   HardeningControl       well-formed; main returns.  Proves the harness,
 *                          the JAR and the VM path are sound, so a failure on
 *                          the malformed classes cannot be blamed on them.
 *   HardeningBadHandler    exception handler whose handler_pc is one past the
 *                          last bytecode.  Before the loader validated
 *                          exception tables, the interpreter resumed there,
 *                          the fetch threw VerifyError, the unwind matched
 *                          the same handler again: a livelock that retired no
 *                          bytecode and never yielded - 100% CPU forever.
 *   HardeningBadField      getfield on an int.  The operand stack is untyped
 *                          and there is no verifier, so the field fast path
 *                          added the field offset to 0x1 and copied from the
 *                          result: SIGSEGV with no exception at all.
 *   HardeningBadPutfield   the same wild pointer on the write side.
 *   HardeningCircularSuper super_class names the class itself; linking it
 *                          recursed into itself until the C stack ran out
 *                          (SIGSEGV).
 *   HardeningIfaceLoop     an interface that lists itself as its
 *                          super-interface; linking it recursed the same way.
 *
 * Assertions:
 *   1. The control class runs and returns normally.
 *   2. Every malformed class comes back with an exception set, twice in a row
 *      (a loader-side rejection must be repeatable, not a one-shot).
 *   3. The process is still alive and the control class still runs after
 *      them: reaching this point is the "no crash" assertion.
 *   4. No case takes more than a few seconds of CPU time.
 *   5. Two create/run/destroy rounds release the same number of host blocks
 *      and load the same number of classes: a rejected class must not leak
 *      state.
 *
 * A SIGALRM watchdog bounds the whole test: if a livelock ever comes back,
 * ctest fails in seconds instead of sitting on its timeout.  (The default
 * action of SIGALRM terminates the process, so no handler is needed.)
 *
 * Usage: test_class_hardening <fixture.jar>
 */
#include "nj2me/nj.h"

#include <stdio.h>
#include <stdlib.h>
#include <string.h>
#include <time.h>

#if !defined(_WIN32)
#include <unistd.h>
#endif

#define ROUNDS 2
#define CASE_BUDGET_SECONDS 5

typedef struct malformed_case {
    const char *cls;    /* class whose main() is called */
    const char *what;   /* the defect it carries, for the failure message */
} malformed_case;

static const malformed_case k_cases[] = {
    { "HardeningBadHandler",
      "Code handler resumes past the end of the method" },
    { "HardeningBadField",
      "getfield receiver is not an object reference" },
    { "HardeningBadPutfield",
      "putfield receiver is not an object reference" },
    { "HardeningCircularSuper",
      "class names itself as its superclass" },
    { "HardeningIfaceLoop",
      "interface names itself as its super-interface" },
};

static const char *const CONTROL = "HardeningControl";

static unsigned char *read_file(const char *path, nj_u4 *out_len)
{
    FILE *f = fopen(path, "rb");
    long n;
    unsigned char *buf;

    if (!f) {
        return NULL;
    }
    if (fseek(f, 0, SEEK_END) != 0) {
        fclose(f);
        return NULL;
    }
    n = ftell(f);
    if (n <= 0) {
        fclose(f);
        return NULL;
    }
    rewind(f);
    buf = (unsigned char *)malloc((size_t)n);
    if (!buf) {
        fclose(f);
        return NULL;
    }
    if (fread(buf, 1u, (size_t)n, f) != (size_t)n) {
        free(buf);
        fclose(f);
        return NULL;
    }
    fclose(f);
    *out_len = (nj_u4)n;
    return buf;
}

/* Call `cls.main(new String[0])`. */
static nj_status call_main(nj_vm *vm, const char *cls)
{
    nj_ref sarr = nj_object_array_new(vm, "java/lang/String", 0u);
    nj_value arg;

    arg.r = sarr;
    return nj_call_static(vm, cls, "main", "([Ljava/lang/String;)V",
                          &arg, NULL);
}

static double cpu_seconds(void)
{
    return (double)clock() / (double)CLOCKS_PER_SEC;
}

/* One create/run/destroy round.  Returns 0 on pass, 1 on failure. */
static int run_round(const unsigned char *jar, nj_u4 jar_len,
                     nj_vm_stats *stats_out)
{
    nj_port port;
    nj_vm *vm;
    nj_app *app;
    nj_u4 released;
    nj_status st;
    size_t i;
    int rc = 1;

    if (nj_port_headless(&port) != NJ_OK) {
        fprintf(stderr, "FAIL: port init failed\n");
        return 1;
    }
    vm = nj_vm_create(&port, 2u * 1024u * 1024u);
    if (!vm) {
        fprintf(stderr, "FAIL: vm create failed\n");
        nj_port_shutdown(&port);
        return 1;
    }
    app = nj_app_open(vm, jar, jar_len);
    if (!app) {
        fprintf(stderr, "FAIL: app open failed (%s)\n",
                nj_exception_describe(vm) ? nj_exception_describe(vm) : "?");
        nj_clear_exception(vm);
        nj_vm_destroy(vm);
        nj_port_shutdown(&port);
        return 1;
    }

    /* 1. The fixture is not broken: the control class must run. */
    st = call_main(vm, CONTROL);
    if (st != NJ_OK) {
        fprintf(stderr, "FAIL: %s.main() threw: %s\n", CONTROL,
                nj_exception_describe(vm) ? nj_exception_describe(vm) : "?");
        nj_clear_exception(vm);
        goto done;
    }
    printf("ok   %-22s valid class runs\n", CONTROL);

    /* 2. Every malformed class must be rejected, repeatably. */
    for (i = 0; i < sizeof(k_cases) / sizeof(k_cases[0]); i++) {
        const malformed_case *c = &k_cases[i];
        unsigned attempt;

        for (attempt = 0u; attempt < 2u; attempt++) {
            double t0 = cpu_seconds();
            double elapsed;

            st = call_main(vm, c->cls);
            elapsed = cpu_seconds() - t0;
            if (st == NJ_OK) {
                fprintf(stderr,
                        "FAIL: %s.main() was accepted (attempt %u): %s\n",
                        c->cls, attempt + 1u, c->what);
                goto done;
            }
            if (!nj_has_exception(vm)) {
                fprintf(stderr,
                        "FAIL: %s.main() failed without an exception "
                        "(attempt %u): %s\n",
                        c->cls, attempt + 1u, c->what);
                goto done;
            }
            if (elapsed > (double)CASE_BUDGET_SECONDS) {
                fprintf(stderr,
                        "FAIL: %s.main() took %.1fs of CPU time; malformed "
                        "input must fail immediately\n",
                        c->cls, elapsed);
                nj_clear_exception(vm);
                goto done;
            }
            if (attempt == 0u) {
                printf("ok   %-22s rejected: %s\n", c->cls,
                       nj_exception_describe(vm) ?
                           nj_exception_describe(vm) : "?");
            }
            nj_clear_exception(vm);
        }
    }

    /* 3. The VM is still usable after all of that. */
    st = call_main(vm, CONTROL);
    if (st != NJ_OK) {
        fprintf(stderr,
                "FAIL: %s.main() threw after the malformed classes: %s\n",
                CONTROL,
                nj_exception_describe(vm) ? nj_exception_describe(vm) : "?");
        nj_clear_exception(vm);
        goto done;
    }
    printf("ok   %-22s still runs after rejected classes\n", CONTROL);
    rc = 0;

done:
    nj_vm_get_stats(vm, stats_out);
    nj_app_close(vm, app);
    released = nj_vm_destroy(vm);
    stats_out->host_live = released;
    nj_port_shutdown(&port);
    return rc;
}

int main(int argc, char **argv)
{
    unsigned char *jar;
    nj_u4 jar_len = 0;
    nj_vm_stats st1, st2;
    int i;

    if (argc < 2) {
        fprintf(stderr, "usage: %s <fixture.jar>\n", argv[0]);
        return 2;
    }
    jar = read_file(argv[1], &jar_len);
    if (!jar) {
        fprintf(stderr, "FAIL: cannot read %s\n", argv[1]);
        return 2;
    }

#if !defined(_WIN32)
    /* A reintroduced livelock must fail the suite, not hang it.  The default
     * SIGALRM action terminates the process, which is exactly what a failed
     * test should do; keep the bound generous enough for a sanitizer build. */
    alarm(120);
#endif

    printf("== nano_j2me malformed-class test ==\n");
    printf("fixture: %s (%u bytes, %u malformed classes)\n", argv[1],
           (unsigned)jar_len,
           (unsigned)(sizeof(k_cases) / sizeof(k_cases[0])));

    for (i = 0; i < ROUNDS; i++) {
        nj_vm_stats *slot = (i == 0) ? &st1 : &st2;
        int rc = run_round(jar, jar_len, slot);

        if (rc != 0) {
            printf("round %d: FAILED\n", i + 1);
            free(jar);
            return 1;
        }
        if (i == 0 && slot->host_live == 0u) {
            printf("FAIL: destroy released nothing, accounting is broken\n");
            free(jar);
            return 1;
        }
        if (i > 0 && slot->host_live != st1.host_live) {
            printf("FAIL: round 2 released %u blocks, round 1 released %u\n",
                   (unsigned)slot->host_live, (unsigned)st1.host_live);
            free(jar);
            return 1;
        }
        printf("round %d: %u host blocks freed at destroy, %u classes\n",
               i + 1, (unsigned)slot->host_live, (unsigned)slot->classes);
    }

    if (st2.host_peak != st1.host_peak) {
        printf("FAIL: host allocation peak drifted between rounds (%u vs %u)\n",
               (unsigned)st1.host_peak, (unsigned)st2.host_peak);
        free(jar);
        return 1;
    }
    if (st2.classes != st1.classes) {
        printf("FAIL: class count drifted between rounds (%u vs %u)\n",
               (unsigned)st1.classes, (unsigned)st2.classes);
        free(jar);
        return 1;
    }

#if !defined(_WIN32)
    alarm(0);
#endif
    printf("\nPASS: malformed class files are rejected with exceptions, "
           "no crash, no hang, no leak\n");
    free(jar);
    return 0;
}
